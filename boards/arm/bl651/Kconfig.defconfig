## boards/arm/bl651/Kconfig.defconfig
```kconfig
# nRF52 DK nRF52810 board configuration

# Copyright (c) 2018 Nordic Semiconductor ASA
# SPDX-License-Identifier: Apache-2.0

if BOARD_BL651

config BOARD
	default "bl651"

endif # BOARD_BL651
```

## boards/arm/bl652/Kconfig.defconfig
```kconfig
# BL652 DVK board configuration

# Copyright (c) 2019 Laird Connectivity
# SPDX-License-Identifier: Apache-2.0

if BOARD_BL652

config BOARD
	default "bl652"

config BT_CTLR
	default BT

endif # BOARD_BL652
```
